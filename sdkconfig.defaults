## sdkconfig.defaults
```kconfig
CONFIG_ESP_WIFI_SSID="DNS_Sniffer_Pro"
CONFIG_ESP_WIFI_PASSWORD="dns12345678"
CONFIG_ESP_MAXIMUM_RETRY=5
CONFIG_ESP_WIFI_SOFTAP_SUPPORT=y
CONFIG_LWIP_MAX_SOCKETS=16
CONFIG_HTTPD_MAX_REQ_HDR_LEN=512
CONFIG_HTTPD_MAX_URI_LEN=512
CONFIG_HTTPD_ERR_RESP_NO_DELAY=y
```
